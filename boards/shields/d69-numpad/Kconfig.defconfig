## boards/shields/d69-numpad/Kconfig.defconfig
```kconfig
if SHIELD_MY_D69NUMPAD

# Name must be less than 16 characters long!
config ZMK_KEYBOARD_NAME
    default "d69numpad"

endif
```

## boards/shields/d69-numpad/Kconfig.shield
```kconfig
# No whitespace after the comma or in your keyboard name!
config SHIELD_MY_D69NUMPAD
    def_bool $(shields_list_contains,d69numpad)
```
